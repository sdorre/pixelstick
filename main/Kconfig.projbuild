## main/Kconfig.projbuild
```kconfig
menu "Project Configuration"
    config RMT_TX_GPIO
        int "RMT TX GPIO"
        default 18
        help
            Set the GPIO number used for transmitting the RMT signal.

    config STRIP_LED_NUMBER
        int "Number of LEDS on a strip"
        default 60
        help
            A single RGB strip contains several LEDs.
endmenu
```
